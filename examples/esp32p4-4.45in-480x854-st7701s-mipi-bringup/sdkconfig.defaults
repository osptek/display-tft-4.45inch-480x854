## examples/esp32p4-4.45in-480x854-st7701s-mipi-bringup/sdkconfig.defaults
```kconfig
# ---- 目标 ----
CONFIG_IDF_TARGET="esp32p4"

# ---- Flash (按实际板子修改) ----
CONFIG_ESPTOOLPY_FLASHSIZE_16MB=y
CONFIG_PARTITION_TABLE_SINGLE_APP_LARGE=y

# ---- CPU / PSRAM (帧缓冲在 PSRAM) ----
CONFIG_IDF_EXPERIMENTAL_FEATURES=y
CONFIG_SPIRAM=y
CONFIG_SPIRAM_MODE_HEX=y
CONFIG_SPIRAM_SPEED_200M=y

# ---- FreeRTOS ----
CONFIG_FREERTOS_HZ=1000

# ---- LVGL ----
CONFIG_LV_CONF_SKIP=y
CONFIG_LV_COLOR_DEPTH_16=y
CONFIG_LV_USE_OBSERVER=y
CONFIG_LV_USE_SYSMON=y
CONFIG_LV_USE_PERF_MONITOR=y
CONFIG_LV_FONT_MONTSERRAT_16=y
CONFIG_LV_FONT_MONTSERRAT_20=y
CONFIG_LV_FONT_DEFAULT_MONTSERRAT_20=y
```
